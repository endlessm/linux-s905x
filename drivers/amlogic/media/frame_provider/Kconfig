## drivers/amlogic/media/frame_provider/Kconfig
```kconfig
#
# Amlogic Decoders
#

menu "Amlogic Decoders"

config AMLOGIC_MEDIA_VDEC_MPEG4
	tristate "CONFIG_AMLOGIC_MEDIA_VDEC_MPEG4"
	default m
	help
		CONFIG_AMLOGIC_MEDIA_VDEC_MPEG4

config AMLOGIC_MEDIA_VDEC_MPEG4_MULTI
	tristate "CONFIG_AMLOGIC_MEDIA_VDEC_MPEG4_MULTI"
	default m
	help
		CONFIG_AMLOGIC_MEDIA_VDEC_MPEG4_MULTI

config AMLOGIC_MEDIA_VDEC_MPEG12
	tristate "CONFIG_AMLOGIC_MEDIA_VDEC_MPEG12"
	default m
	help
		CONFIG_AMLOGIC_MEDIA_VDEC_MPEG12

config AMLOGIC_MEDIA_VDEC_VC1
	tristate "CONFIG_AMLOGIC_MEDIA_VDEC_VC1"
	default m
	help
		CONFIG_AMLOGIC_MEDIA_VDEC_VC1

config AMLOGIC_MEDIA_VDEC_H264
	tristate "CONFIG_AMLOGIC_MEDIA_VDEC_H264"
	default m
	help
		CONFIG_AMLOGIC_MEDIA_VDEC_H264

config AMLOGIC_MEDIA_VDEC_H264_MULTI
	tristate "CONFIG_AMLOGIC_MEDIA_VDEC_H264_MULTI"
	default m
	help
		CONFIG_AMLOGIC_MEDIA_VDEC_H264_MULTI

config AMLOGIC_MEDIA_VDEC_H264_MVC
	tristate "CONFIG_AMLOGIC_MEDIA_VDEC_H264_MVC"
	default m
	help
		CONFIG_AMLOGIC_MEDIA_VDEC_H264_MVC

config AMLOGIC_MEDIA_VDEC_H264_4K2K
	tristate "CONFIG_AMLOGIC_MEDIA_VDEC_H264_4K2K"
	default m
	help
		CONFIG_AMLOGIC_MEDIA_VDEC_H264_4K2K

config AMLOGIC_MEDIA_VDEC_H265
	tristate "CONFIG_AMLOGIC_MEDIA_VDEC_H265"
	default m
	help
		CONFIG_AMLOGIC_MEDIA_VDEC_H265

config AMLOGIC_MEDIA_VDEC_VP9
	tristate "CONFIG_AMLOGIC_MEDIA_VDEC_VP9"
	default m
	help
		CONFIG_AMLOGIC_MEDIA_VDEC_VP9

config AMLOGIC_MEDIA_VDEC_MJPEG
	tristate "CONFIG_AMLOGIC_MEDIA_VDEC_MJPEG"
	default m
	help
		CONFIG_AMLOGIC_MEDIA_VDEC_MJPEG

config AMLOGIC_MEDIA_VDEC_MJPEG_MULTI
	tristate "CONFIG_AMLOGIC_MEDIA_VDEC_MJPEG_MULTI"
	default m
	help
		CONFIG_AMLOGIC_MEDIA_VDEC_MJPEG_MULTI

config AMLOGIC_MEDIA_VDEC_REAL
	tristate "CONFIG_AMLOGIC_MEDIA_VDEC_REAL"
	default m
	help
		CONFIG_AMLOGIC_MEDIA_VDEC_REAL

config AMLOGIC_MEDIA_VDEC_AVS
	tristate "CONFIG_AMLOGIC_MEDIA_VDEC_AVS"
	default m
	help
		CONFIG_AMLOGIC_MEDIA_VDEC_AVS

endmenu
```

## drivers/amlogic/media/frame_sink/Kconfig
```kconfig
#
# Amlogic Encoders
#

menu "Amlogic Encoders"

config AMLOGIC_MEDIA_VENC_H264
	tristate "CONFIG_AMLOGIC_MEDIA_VENC_H264"
	default m
	help
		CONFIG_AMLOGIC_MEDIA_VENC_H264

config AMLOGIC_MEDIA_VENC_H265
	tristate "CONFIG_AMLOGIC_MEDIA_VENC_H265"
	default m
	help
		CONFIG_AMLOGIC_MEDIA_VENC_H265

endmenu
```

## drivers/gpu/drm/meson/Kconfig
```kconfig
config DRM_MESON
	tristate "DRM Support for Amlogic Meson Display Controller"
	depends on DRM && OF
	select DRM_KMS_HELPER
	select DRM_KMS_CMA_HELPER
	select DRM_GEM_CMA_HELPER
	select VIDEOMODE_HELPERS
```

## s905x.its
```
/dts-v1/;
/ {
	description = "Amlogic S905X kernel and FDT";
	#address-cells = <1>;

	images {
		kernel@1 {
			description = "Linux 3.x";
			data = /incbin/("arch/arm64/boot/Image");
			type = "kernel";
			arch = "arm64";
			os = "linux";
			compression = "none";
			load = <0x1080000>;
			entry = <0x1080000>;
			hash@1 {
				algo = "crc32";
			};
		};
		fdt@1 {
			description = "Amlogic S905X Flattened Device Tree blob";
			data = /incbin/("arch/arm64/boot/dts/endless_s905x.dtb");
			type = "flat_dt";
			arch = "arm64";
			compression = "none";
			hash@1 {
				algo = "crc32";
			};
		};
	};

	configurations {
		default = "s905x";
		s905x {
			description = "Boot Endless S905X";
			kernel = "kernel@1";
			fdt = "fdt@1";
		};
	};
};
```
